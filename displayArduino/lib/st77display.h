#ifndef ST77DISPLAY_H
#define ST77DISPLAY_H

#include "helper.h"
#include "spiAVR.h"
#include "serialATmega.h"
#include <avr/io.h>
#include <avr/interrupt.h>
#include <util/delay.h>

#define RES_PIN PB4
#define AO_PIN PB0
#define CS_PIN PB2

#define AO_OFF          PORTB &= ~(1 << AO_PIN)
#define AO_ON           PORTB |= (1 << AO_PIN)
#define CS_OFF          PORTB &= ~(1 << CS_PIN)
#define CS_ON           PORTB |= (1 << CS_PIN)
#define RESET_OFF       PORTB &= ~(1 << RES_PIN)
#define RESET_ON        PORTB |= (1 << RES_PIN)

#define BLACK           0x0000
#define WHITE           0xFFFF
#define BLUE            0xF800
#define GREEN           0x07E0
#define RED             0x001F
#define YELLOW          0x07FF
#define PINK            0xF81F
#define CYAN            0xFFE0
#define MAGENTA         0xFC18
#define GRAY            0x8410

int size, size2;

void send_command(uint8_t cmd) {
    AO_OFF;
    CS_OFF;
    SPI_SEND(cmd);
    CS_ON;
}

void pass_data(uint8_t data) {
    AO_ON;
    CS_OFF;
    SPI_SEND(data);
    CS_ON;
}

void set_column(uint16_t start, uint16_t end) {
    send_command(0x2A);
    pass_data(start >> 8);
    pass_data(start & 0xFF);
    pass_data(end >> 8);
    pass_data(end & 0xFF);
}

void set_row(uint16_t start, uint16_t end) {
    send_command(0x2B);
    pass_data(start >> 8);
    pass_data(start & 0xFF);
    pass_data(end >> 8);
    pass_data(end & 0xFF);
}

void write_pixel(uint16_t color) {
    pass_data((color >> 8) & 0xFF);
    pass_data(color & 0xFF);
}

void populate_screen(uint16_t color) {
    set_column(0, 127);
    set_row(0, 159);
    send_command(0x2C);

    for (uint32_t i = 0; i < 128 * 160; ++i) {
        write_pixel(color);
    }
}

void write_to_screen(int startRow, int endRow, int startColumn, int endColumn, int color) {
    set_column(startColumn, endColumn);
    set_row(startRow, endRow);
    send_command(0x2C);

    for (int i = startRow; i < (endRow - startRow + 1) * (endColumn - startColumn + 1); ++i) {
        write_pixel(color);
    }
}

void SPI_SEND_NEW(uint8_t data) {
    SPDR = data;
    while(!(SPSR & (1 << SPIF))); 
}

void reset_whole() {
  RESET_OFF;
  _delay_ms(200);
  RESET_ON;
  _delay_ms(200);
}

void ST7735_Init() {
    reset_whole();
    PORTB = SetBit(PORTB, 1, 0);
    PORTB = SetBit(PORTB, 2, 0);
    _delay_ms(200);
    send_command(0x11);
    _delay_ms(200);
    send_command(0x36);
    pass_data(0x00); 
    send_command(0x3A); 
    pass_data(0x05); 
    send_command(0x29); 
    _delay_ms(200);
    set_column(0, 127);
    set_row(0, 159);
}

const uint8_t largerFont[96][10] = {
    {0x00, 0x00, 0x00, 0x00, 0x00, 0x00, 0x00, 0x00, 0x00, 0x00}, // ' ' (space)
    {0x00, 0x00, 0x18, 0x18, 0x18, 0x18, 0x18, 0x00, 0x18, 0x00}, // '!'
    {0x00, 0x66, 0x66, 0x66, 0x66, 0x00, 0x00, 0x00, 0x00, 0x00}, // '"'
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    {0x00, 0x66, 0xFF, 0xDB, 0xDB, 0xFF, 0x66, 0x00, 0x00, 0x00}  // '<-'
};

void draw_char(uint16_t x, uint16_t y, char c, uint16_t color, float scale) {
    serial_println(c);
    if (c < ' ' || c > '~') return; // Check for valid ASCII range
    int index = c - ' ';
    for (int i = 0; i < 10; i++) {
        uint8_t line = largerFont[index][i];
        for (int j = 0; j < 8; j++) {
            if (line & (1 << (7 - j))) { // Check if the bit is set
                for (int k = 0; k < scale; k++) {
                    for (int l = 0; l < scale; l++) {
                        set_column(x + (j * scale) + k, x + (j * scale) + k + 1);
                        set_row(y + (i * scale) + l, y + (i * scale) + l + 1);
                        send_command(0x2C); // RAMWR
                        write_pixel(color);
                    }
                }
            }
        }
    }
}


#endif